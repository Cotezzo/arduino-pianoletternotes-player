#include <Tone.h>

// CHARLIE PINS DECLARATION, LEDS DECLARATION
const int CH_1 = 10;
const int CH_2 = 11;
const int CH_3 = 12;
const int CH_4 = 13;

uint8_t charliePins[] = { CH_1, CH_2, CH_3, CH_4 };
const byte charliePinsSize = sizeof(charliePins)/sizeof(charliePins[0]);
  
byte lights[12];
const byte lightsSize = sizeof(lights) / sizeof(lights[0]);

// Broken LEDs stuff
boolean previousLEDsState = true;
const byte set1[] = { 0, 2, 4, 7, 9, 11 };
const byte set2[] = { 1, 3, 5, 6, 8, 10 };
const byte setSize = 6;


// NOTES POOL TO REDUCE ARRAY SIZE USING BYTES
const int n[] = {
  NOTE_B0, NOTE_C1, NOTE_CS1, NOTE_D1, NOTE_DS1, NOTE_E1, NOTE_F1, NOTE_FS1, NOTE_G1, NOTE_GS1, NOTE_A1, NOTE_AS1, NOTE_B1, NOTE_C2, NOTE_CS2, NOTE_D2, NOTE_DS2, NOTE_E2, NOTE_F2, NOTE_FS2, NOTE_G2, NOTE_GS2, NOTE_A2, NOTE_AS2,
  NOTE_B2, NOTE_C3, NOTE_CS3, NOTE_D3, NOTE_DS3, NOTE_E3, NOTE_F3, NOTE_FS3, NOTE_G3, NOTE_GS3, NOTE_A3, NOTE_AS3, NOTE_B3, NOTE_C4, NOTE_CS4, NOTE_D4, NOTE_DS4, NOTE_E4, NOTE_F4, NOTE_FS4, NOTE_G4, NOTE_GS4, NOTE_A4, NOTE_AS4,
  NOTE_B4, NOTE_C5, NOTE_CS5, NOTE_D5, NOTE_DS5, NOTE_E5, NOTE_F5, NOTE_FS5, NOTE_G5, NOTE_GS5, NOTE_A5, NOTE_AS5, NOTE_B5, NOTE_C6, NOTE_CS6, NOTE_D6, NOTE_DS6, NOTE_E6, NOTE_F6, NOTE_FS6, NOTE_G6, NOTE_GS6, NOTE_A6, NOTE_AS6,
  NOTE_B6, NOTE_C7, NOTE_CS7, NOTE_D7, NOTE_DS7, NOTE_E7, NOTE_F7, NOTE_FS7, NOTE_G7, NOTE_GS7, NOTE_A7, NOTE_AS7, NOTE_B7, NOTE_C8, NOTE_CS8, NOTE_D8, NOTE_DS8
};

// ACTUAL MELODY
// Layer 1
const byte notes[] = {
  // 16,0,28,0,16,0,28,0,16,0,28,0,16,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0
  // 14,21,26,29,33,26,29,33,38,29,33,38,41,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33
  // 49,15,15,15,15,15,15,51,49,15,15,15,49,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65  
  // 0,0,0,0,0,0,0,0,0,0,0,0,53,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60
  // 17,0,0,0,20,0,0,0,27,0,0,26,0,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26
  // 53,0,29,0,48,0,49,0,51,0,53,51,49,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0
  // 34,34,0,0,37,37,0,0,39,39,0,25,41,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25
  // 49,0,0,0,0,0,0,0,52,0,0,0,0,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61
  20,0,27,0,32,0,34,0,0,0,36,0,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0
};

// Layer 2
const byte notes2[] = {
  // 4,0,23,0,4,0,23,0,4,0,23,0,4,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0
  // 0,0,21,0,14,0,21,0,14,0,21,0,14,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0
  // 44,3,3,3,3,3,3,15,42,3,3,3,44,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53
  // 0,0,0,0,0,0,0,0,0,0,0,0,41,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0
  // 0,0,0,0,0,0,0,0,0,0,0,0,0,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0
  // 17,0,0,0,17,0,29,0,17,0,29,0,17,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0
  0,0,0,0,0,0,0,0,0,0,0,0,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0
};

const int songSize = sizeof(notes)/sizeof(notes[0]);
const byte noteDuration = 95;

// AUDIO DEVICES SETUP
Tone AUDIO_SX;
Tone AUDIO_DX;

void setup() {
  AUDIO_SX.begin(3);
  AUDIO_DX.begin(2);
  playMelody();
}

void loop(){}

// PLAY SONG FUNCTION
void playMelody(){
  int i = 0;
  while(i < songSize){
    
    /*
    if(previousLEDsState == true)
      draw(set1, setSize);
    else
      draw(set2, setSize);
    delay(1);
    */
      
    // if(AUDIO_SX.isPlaying() || AUDIO_DX.isPlaying()) continue;

    if(AUDIO_SX.isPlaying()) continue;      
    // if(AUDIO_DX.isPlaying()) continue;      
    AUDIO_SX.stop();
    AUDIO_DX.stop();
    
    // previousLEDsState = !previousLEDsState;


    const int mainNote = notes[i];
    const int secnNote = notes2[i];
    if(mainNote == 0 && secnNote == 0) delay(noteDuration);
    // if(mainNote == 0) delay(80);
    if(mainNote != 0) AUDIO_SX.play(n[mainNote], noteDuration);
    if(secnNote != 0) AUDIO_DX.play(n[secnNote], noteDuration);
    
    
    i++;
  }

  playMelody();
}

void draw(byte lightLEDs[], byte sz){
  byte count = 0;
  while(count < noteDuration){
    count++;
    for(byte i = 0; i < sz; i++){                                         // For every light up LED, set Charlieplex properly
      const byte LED_ID = lightLEDs[i];                                   // Get the LED_ID from the lighted LEDs array
      const byte t = LED_ID % 6;                                          // Normalize (get two endpoints of the LED, flow direction is handled here: --| )
      const byte Vcc = t % 4;                                             // Get the first CH pin                                                       |
      const byte GND = (Vcc + (t > 3 ? 2 : 1)) % 4;                       // Get the second CH pin                                                     \ /
      if(LED_ID < 6)                                                      // Every connection has two possible flows, handled as 2 rows here. Based on the index, choose the row.
        setCharlies(Vcc, GND);
      else
        setCharlies(GND, Vcc);
    }
    delay(1);
  }
}

// SET CHARLIE PINS
void setCharlies(byte HighIndex, byte LowIndex){
  // [ CH1, CH2, CH3, CH4 ];
  byte i = 0;
  while(i < charliePinsSize){
    if(i == HighIndex)
      setCharlie(i, OUTPUT, HIGH);
    else if(i == LowIndex)
      setCharlie(i, OUTPUT, LOW);
    else
      setCharlie(i, INPUT, LOW);
    i++;
  }
}

void setCharlie(byte i, byte IO, byte HL){
  pinMode(charliePins[i], IO);
  digitalWrite(charliePins[i], HL);
}
