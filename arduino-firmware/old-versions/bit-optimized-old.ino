#include <Tone.h>

// NOTES POOL TO REDUCE ARRAY SIZE USING BYTES
const int notes[] = {
  NOTE_B0, NOTE_C1, NOTE_CS1, NOTE_D1, NOTE_DS1, NOTE_E1, NOTE_F1, NOTE_FS1, NOTE_G1, NOTE_GS1, NOTE_A1, NOTE_AS1, NOTE_B1, NOTE_C2, NOTE_CS2, NOTE_D2, NOTE_DS2, NOTE_E2, NOTE_F2, NOTE_FS2, NOTE_G2, NOTE_GS2, NOTE_A2, NOTE_AS2,
  NOTE_B2, NOTE_C3, NOTE_CS3, NOTE_D3, NOTE_DS3, NOTE_E3, NOTE_F3, NOTE_FS3, NOTE_G3, NOTE_GS3, NOTE_A3, NOTE_AS3, NOTE_B3, NOTE_C4, NOTE_CS4, NOTE_D4, NOTE_DS4, NOTE_E4, NOTE_F4, NOTE_FS4, NOTE_G4, NOTE_GS4, NOTE_A4, NOTE_AS4,
  NOTE_B4, NOTE_C5, NOTE_CS5, NOTE_D5, NOTE_DS5, NOTE_E5, NOTE_F5, NOTE_FS5, NOTE_G5, NOTE_GS5, NOTE_A5, NOTE_AS5, NOTE_B5, NOTE_C6, NOTE_CS6, NOTE_D6, NOTE_DS6, NOTE_E6, NOTE_F6, NOTE_FS6, NOTE_G6, NOTE_GS6, NOTE_A6, NOTE_AS6,
  NOTE_B6, NOTE_C7, NOTE_CS7, NOTE_D7, NOTE_DS7, NOTE_E7, NOTE_F7, NOTE_FS7, NOTE_G7, NOTE_GS7, NOTE_A7, NOTE_AS7, NOTE_B7, NOTE_C8, NOTE_CS8, NOTE_D8, NOTE_DS8
};  // static note values (declared in Tone.h)

/* ---- ACTUAL MELODY ----------------------------------------------------------------------------------------------------------------------------------------------------------------- */
// SX Layer
const uint8_t hexMap_SX[] = {
0x80,0x80,0x82,0x08,0x80,0x88,0xa2,0x00,0x80,0x80,0x82,0x08,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0x09
};

const uint8_t PROGMEM hexNotes_SX[] = {
0x62,0xd1,0xb3,0x46,0xcd,0x9d,0xb9,0x70,0xd9,0xc3,0x87,0x6f,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0x3d
};

// DX Layer
const uint8_t hexMap_DX[] = {
0x80,0x00,0x80,0x00,0x80,0x00,0x80,0x00,0x80,0x00,0x80,0x00,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0x09
};

const uint8_t PROGMEM hexNotes_DX[] = {
0x50,0x95,0x3a,0x85,0x09,0x53,0xa5,0x4a,0x8d,0x01,0xe4,0x07,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0x11
};
/* ------------------------------------------------------------------------------------------------------------------------------------------------------------------------------------ */

const int songSize = (sizeof(hexMap_SX) / sizeof(hexMap_SX[0])) * 8; // 1 bit => 1 note
const byte noteDuration = 70;

// AUDIO DEVICES SETUP
Tone AUDIO_SX;
Tone AUDIO_DX;

// Run once
void setup() {
  AUDIO_SX.begin(3);
  AUDIO_DX.begin(2);
  playMelody();
}

// Run repeateadly
void loop() {} // Put there playMelody()??

// PLAY SONG FUNCTION
void playMelody() {

  // SX variables init
  int hexNotesIndex_SX = -1;
  byte mask_SX_1 = 0xff;
  byte mask_SX_2 = 0xff;
  byte shift_SX = 7;

  int hexNotesIndex_DX = -1;
  byte mask_DX_1 = 0xff;
  byte mask_DX_2 = 0xff;
  byte shift_DX = 7;

  int i = 0;
  while (i < songSize) {

    if(AUDIO_SX.isPlaying()) continue;
    // AUDIO_SX.stop();
    // AUDIO_DX.stop();

    // Common
    const byte haxMapIndex = i / 8;
    const byte haxMapBitIndex = 7 - (i % 8);
    const byte isNote_SX = bitRead(hexMap_SX[haxMapIndex], haxMapBitIndex); // Example: i = 5, number 0, 6th bit.
    const byte isNote_DX = bitRead(hexMap_DX[haxMapIndex], haxMapBitIndex); // Example: i = 5, number 0, 6th bit.
    i++;  // Increment only if a note or pause will play (passed AUDIO.isPlaying())


    // Check if there is something to play - if there's not, pause note
    if (!isNote_SX && !isNote_DX)
      delay(noteDuration);    // pause note
    else {

      // Play SX note, setup masks, corrections, get notes data from PROGMEM, parse it, get note index, play note
      if (isNote_SX) {

        if (mask_SX_2 == 0x00) {  // Reset variables every 8 cycles and apply correction
          mask_SX_2 = ~mask_SX_2;       // Indirectly set mask_1 to 0b00000000, mask_2 to 0b11111110
          hexNotesIndex_SX--;             // This and delete completely indexCorrection
          shift_SX = 7;
        }

        mask_SX_1 = ~mask_SX_2;         // No need to save mask_1 externally (or internally, use it direcly since it doesn't need to be stored)
        mask_SX_2 = mask_SX_2 << 1;     // Only save mask_2, used to generate the next values

        byte buffer[2];     // Save necessary values from PROGMEM into buffer
        buffer[0] = pgm_read_byte(&hexNotes_SX[hexNotesIndex_SX]);      // note chunk #1
        buffer[1] = pgm_read_byte(&hexNotes_SX[hexNotesIndex_SX + 1]);  // note chunk #

        // Use bit masks and shifts to get the 7-bits number from the PROGMEM notes layer
        const byte note_index_SX = ((buffer[0] & mask_SX_1) << shift_SX ) | ((buffer[1] & mask_SX_2) >> (8 - shift_SX));
        shift_SX--;   // Decrement shift correction (will reset to 7 when 0 aka when mask_2 == 0b00000000)
        hexNotesIndex_SX++;   // Next index MAYBE DECREMENT THIS INSTEAD OF INDEXCORRECTION

        // Actual note play :D
        AUDIO_SX.play(notes[note_index_SX], noteDuration);
      }

      if (isNote_DX) {

        if (mask_DX_2 == 0x00) {  // Reset variables every 8 cycles and apply correction
          mask_DX_2 = ~mask_DX_2;       // Indirectly set mask_1 to 0b00000000, mask_2 to 0b11111110
          hexNotesIndex_DX--;             // This and delete completely indexCorrection
          shift_DX = 7;
        }

        mask_DX_1 = ~mask_DX_2;         // No need to save mask_1 externally (or internally, use it direcly since it doesn't need to be stored)
        mask_DX_2 = mask_DX_2 << 1;     // Only save mask_2, used to generate the next values

        byte buffer[2];     // Save necessary values from PROGMEM into buffer
        buffer[0] = pgm_read_byte(&hexNotes_DX[hexNotesIndex_DX]);      // note chunk #1
        buffer[1] = pgm_read_byte(&hexNotes_DX[hexNotesIndex_DX + 1]);  // note chunk #

        // Use bit masks and shifts to get the 7-bits number from the PROGMEM notes layer
        const byte note_index_DX = ((buffer[0] & mask_DX_1) << shift_DX ) | ((buffer[1] & mask_DX_2) >> (8 - shift_DX));
        shift_DX--;   // Decrement shift correction (will reset to 7 when 0 aka when mask_2 == 0b00000000)
        hexNotesIndex_DX++;   // Next index MAYBE DECREMENT THIS INSTEAD OF INDEXCORRECTION

        // Actual note play :D
        AUDIO_DX.play(notes[note_index_DX], noteDuration);
      }
    }
  }

  delay(500);
  playMelody();
}
